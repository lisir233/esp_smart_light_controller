## sdkconfig.defaults.esp32c3
```kconfig
#Enable Power Management
CONFIG_PM_ENABLE=y
CONFIG_PM_DFS_INIT_AUTO=y
CONFIG_PM_SLP_DISABLE_GPIO=y

CONFIG_FREERTOS_HZ=1000
CONFIG_FREERTOS_USE_TICKLESS_IDLE=y
CONFIG_FREERTOS_IDLE_TIME_BEFORE_SLEEP=3


CONFIG_ESP_PHY_MAC_BB_PD=y


CONFIG_ESP_SLEEP_GPIO_RESET_WORKAROUND=y
CONFIG_ESP32C3_RTC_CLK_SRC_EXT_CRYS=y


CONFIG_ESP_SLEEP_FLASH_LEAKAGE_WORKAROUND=y

CONFIG_ESP_WIFI_SLP_DEFAULT_MIN_ACTIVE_TIME=17
CONFIG_ESP_WIFI_SLP_DEFAULT_MAX_ACTIVE_TIME=60
CONFIG_ESP_WIFI_STA_DISCONNECTED_PM_ENABLE=y
```
